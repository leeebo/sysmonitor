## Kconfig
```kconfig
menu "Sysmonitor Configuration"

    config TASKMONITOR_MAX_TASKS
        int "Maximum number of tasks being monitored"
        default 30

    config TASKMONITOR_DUMP_INTERVAL
        int "Task monitor dump interval (in seconds)"
        default 3

endmenu
```

## examples/taskmonitor/sdkconfig.defaults
```kconfig
#
# FreeRTOS
#
CONFIG_FREERTOS_SUPPORT_STATIC_ALLOCATION=y
CONFIG_FREERTOS_TIMER_TASK_STACK_DEPTH=4096
CONFIG_FREERTOS_USE_TRACE_FACILITY=y
CONFIG_FREERTOS_GENERATE_RUN_TIME_STATS=y
CONFIG_FREERTOS_RUN_TIME_STATS_USING_ESP_TIMER=y
```
